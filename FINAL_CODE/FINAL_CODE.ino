//#include <Adafruit_ATParser.h>
//#include <Adafruit_BLE.h>
//#include <Adafruit_BLEBattery.h>
//#include <Adafruit_BLEMIDI.h>
//#include <Adafruit_BluefruitLE_SPI.h>
//#include <Adafruit_BluefruitLE_UART.h>
#include <Wire.h>
#include <Adafruit_MotorShield.h>

#if SOFTWARE_SERIAL_AVAILABLE
  #include <SoftwareSerial.h>
#endif

#include <Servo.h>



 Adafruit_MotorShield AFMS = Adafruit_MotorShield(); 
 Adafruit_DCMotor *Motor1 = AFMS.getMotor(1);
 Adafruit_DCMotor *Motor2 = AFMS.getMotor(2);
   
 
//Useful Variables
  int state;
  int incomingByte;
  int val;
  

 Servo s1; Servo s2;
     

void setup() {
  
      
    // Initialize serial communication at 9600 bits per second:
    Serial.begin(9600);
    s1.attach(9);  s2.attach(10); 
    s1.write(90);  s2.write(90); 
    
    Serial.println("Adafruit Motorshield v2 - DC Motor test!");

  AFMS.begin(); 
  Motor1->setSpeed(50);
  Motor1->run(FORWARD);
  // turn on motor
  Motor1->run(RELEASE);  
  Motor2->setSpeed(50);
  Motor2->run(FORWARD);
  // turn on motor
  Motor2->run(RELEASE);  
}
 
void loop() {
 
  //Save income data to variable 'state'
    if(Serial.available() > 0){     
      state = Serial.read(); 
      incomingByte = Serial.read();
      Serial.print("USB recieved: ");
      Serial.println(state);
        
    }
  
  //Change speed if state is equal from 0 to 4. Values must be from 0 to 255 (PWM)
    if (state == '0'){
       Motor1->setSpeed(0);
       Motor2->setSpeed(0);}
    else if (state == '1'){
       Motor1->setSpeed(25);
       Motor2->setSpeed(25);}
    else if (state == '2'){
       Motor1->setSpeed(50);
       Motor2->setSpeed(50);}
    else if (state == '3'){
       Motor1->setSpeed(75);
       Motor2->setSpeed(75);}
    else if (state == '4'){
      Motor1->setSpeed(100);
       Motor2->setSpeed(100);
       }
 	  
  /***********************Forward****************************/
  //If state is equal with letter 'F', car will go forward!
    if (state == 'F') {
    	 Motor1->run(FORWARD);
       Motor2->run(FORWARD);
      delay(100);
    }
  
  /***********************Backward****************************/
  //If state is equal with letter 'B', car will go backward
    else if (state == 'B') {
    	Motor1->run(BACKWARD);
      Motor2->run(BACKWARD);
     delay(10);
    }
  

  /************************Stop*****************************/
  //If state is equal with letter 'S', stop the car
    else if (state == 'S'){
        Motor1->run(RELEASE);
        Motor2->run(RELEASE);
        delay(10);
    }

   /**********************Turning**************************/
  else if (state == 'T'){
      val = map (incomingByte - 48, 5, 9, 50, 130);   //// 7 IS 90 DEGREES
      s1.write(180 - val); s2.write(val);
      delay(50);
    }
}













































































































































































































































































































































































































































































































































































































































































































































































































































































































































































































































































































































































































































































































































































































































































































































































































































































































































































































































































































































































































































































































































































































































































































































































































































































































































































































































































































































































































































































































































































































































































































































































































































































































































































































































































































































































































































































































































































































































































































































































































































































































































































































































































































































































































































































































































































































































































































































































































































































































































































































































































































































































































































































































































































































































































































































































































































































































































































































































































































 
    




